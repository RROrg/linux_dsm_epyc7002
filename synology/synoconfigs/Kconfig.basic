## synology/synoconfigs/Kconfig.misc
```kconfig
menu "MISC Features"

config SYNO_APPARMOR_PATCH
	bool "Apply Synology patch for AppArmor"
	default y
	depends on SECURITY_APPARMOR

config SYNO_OOM_DEBUG
	bool "Dump modules and occupied memory sizes while OOM"
	default y

config SYNO_ELEVATE_LOG_LEVEL
	bool "Elevate log level of kernel log"
	default y

config SYNO_FORCE_CF9_REBOOT
	bool "Support CF9 Force reboot"
	default n
	depends on (X86_64 && !KGDB_KDB)

config SYNO_OOM_NOTIFICATION
	bool "Support oom notification"
	default y

config SYNO_KERNEL_MODULE_REMOVAL_LOGGING
	bool "add logging about kernel module removal"
	default y

config SYNO_POWEROFF_INFO_PRINT
	bool "Show pma1 and pma2 in poweroff procedure"
	default n

config SYNO_PSTORE
	bool "Synology enhancement of Pstore mechanism"
	default n
	depends on PSTORE

config SYNO_SPECULATION_DEFAULT_OFF
	bool "Set speculation mitigation to default off"
	default n
	depends on PAGE_TABLE_ISOLATION

config SYNO_FIX_RTC_WAKE_AFTER_POWER_FAILURE
	bool "fix rtc wake after power failure"
	default y
	depends on SYNO_X64

config SYNO_PLUGIN_INTERFACE
        bool "Synology plugin interface for kernel modules"
        default y

config SYNO_UART_TO_SPI_CONSOLE_LOG
	tristate "sysfs for trigger uart to spi log out gpio"
	default n
	depends on SYNO_LIBS && SYNO_OF

config SYNO_SYSTEM_SHUTDOWN_HOOK
	bool "customized functions exectuted before system shutdown/reboot"
	default y

config SYNO_SYNOBIOS_EVENT
	bool "send event to user space through synobios"
	default y

config SYNO_KVM_IGNORE_MSRS
	bool "skip logging of ignored MSRS"
	default y
	depends on KVM

config SYNO_DISABLE_AUDITSYSCALL
	bool "disable kernel always do syscall auditing"
	default y
	depends on AUDIT

config SYNO_DEV_ALLOC_PAGES
	bool "Enable synology dev alloc pages"
	default y

config SYNO_OUT_OF_RESOURCE_LOG
	bool "log for out of resource event occurrence"
	default y

config SYNO_RND_ENTROPY_GEN
	bool "generate random entropy"
	default y

config SYNO_ACPI_APEI_AER_DBGMSG
	bool "Print AER register in APCI APEI log"
	default y
	depends on ACPI_APEI_PCIEAER

endmenu #MISC Features

menu "Cgroup"

endmenu #Cgroup

menu "Encryption"
config SYNO_CRYPTO_REMOVE_X509_DATE_VALIDATION_CONSTRAIN
	bool "Remove x509 date validation constrain"
	depends on KEYS

endmenu #Encryption

menu "Udev"

config SYNO_DEPRECATED_UEVENT_ENV
	bool "Export deprecate uevent environment to userspace"
	default y

endmenu #Udev

menu "Bios Log"

config SYNO_BIOS_MEMORY_TRAINING_FAILED_LOG
	bool "Print the MRC postcode if memory training fail happened at last boot up"
	depends on X86
	default y

config SYNO_BIOS_MRC_POSTCODE_CMOS_ADDR
	hex "The address of cmos storing failed MRC postcode"
	depends on SYNO_BIOS_MEMORY_TRAINING_FAILED_LOG
	default 0x48

config SYNO_BIOS_ACPI_FPDT
	bool "ACPI Firmware Performance Data Table(FPDT)"
	depends on X86_64 && ACPI
	default y

config SYNO_BIOS_WARNING_FLAGS
	bool "Warning if some BIOS flags exist"
	depends on X86_64
	default y

endmenu #BIOS LOG

menu "ceph"

config SYNO_CEPH_CUSTOMIZED_CRUSH
	bool "customized crush rule for synology hyper converged platform"
	depends on CEPH_LIB
	default y

config SYNO_CEPH_SKIP_CRC
	bool "skip crc32 calculation"
	depends on CEPH_LIB
	default y

config SYNO_CEPH_IDENTIFY_POOL_XATTR_IS_ID
	bool "identify whether the pool xattr is pool id"
	depends on CEPH_LIB
	default y

endmenu #ceph

menu "Synology Protection"

config SYNO_RAMDISK_INTEGRITY_CHECK
	bool "Confirm the integrity of ramdisk (rd.gz) is correct and prevent to suffer tampering"
	default y
	depends on X86_64

config SYNO_KEXEC_TEST
	bool "Test whether the kernel is booted with Kexec"
	default y
	depends on X86_64

endmenu # Synology Protection

menu "TPM"

config SYNO_TPM_TIMEOUT_ADJUST_AND_RETRY
	bool "adjust tpm command timeout and retry"
	depends on TCG_TPM
	default n

endmenu #TPM
```

## synology/synoconfigs/Kconfig.network
```kconfig
menu "Network"

config SYNO_SFP_UNSUPPORTED_NOTIFY
	bool "SFP+ module unsupported notify"
	default y

config SYNO_SKIP_RXDROP_BY_CORE
	bool "Skip RX packets drop is increasing"
	default y

config SYNO_IPV6_RFC_4862
	bool "IPv6 Stateless Address Autoconfiguration"
	default y

config SYNO_BONDING_INIT_STATUS
	bool "Initial the bonding status"
	default y

config SYNO_BONDING_FIX_ACTIVE
	bool "Fix a bug in active backup bonding mode"
	default y

config SYNO_IPV6_LINKLOCAL
	bool "Assign an interface to IPV6 link local address automatically."
	default y

config SYNO_OVS_MODE_REFINEMENT
	bool "Refine Synology Open vSwitch Mode"
	default y

config SYNO_NF_NAT_WORKAROUND
	bool "Fix BUG_ON on nf_nat_setup_info"
	default y

config SYNO_NET_ALB_FIX_OVERFLOW
	bool "Fix the overflow bug in alb tx balance mechanism"
	default y

config SYNO_NET_ALB_USE_64BIT_LOAD
	bool "use 64 bit varialbe to store load of each tx slave/client"
	default y

config SYNO_NET_EMULEX_HIDE_VF
	bool "Not to probe emulex vf by real host"
	default y
	depends on BE2NET

config SYNO_AMD_XGBE_PORTING
	bool "AMD Xgbe driver porting"
	default n
	depends on AMD_XGBE

endmenu #Network
```

## synology/synoconfigs/Kconfig.platform
```kconfig
menu "Platform Features"
config SYNO_X64
	bool
	default y
	depends on X86_64

config SYNO_SELECT_PLATFORM
	def_bool y
choice
	prompt "Synology platform"

config SYNO_KVMX64
	bool "KVM X64 Virtual machine"
	depends on X86_64

config SYNO_KVMX64SOFS
	bool "KVM X64 Virtual machine with SOFS"
	depends on X86_64

config SYNO_KVMX64V2
	bool "KVM X64 Virtual machine with port mapping v2"
	depends on X86_64

config SYNO_BROADWELL
	bool "Intel-Broadwell"
	depends on X86_64

config SYNO_PURLEY
	bool "Intel Purley"
	depends on X86_64

config SYNO_GEMINILAKE
	bool "Intel-Geminilake"
	depends on X86_64

config SYNO_V1000
	bool "AMD Ryzen Embedded V1000"
	depends on X86_64

config SYNO_V1000SOFS
	bool "AMD Ryzen Embedded V1000 with SOFS"
	depends on X86_64

config SYNO_RTD1619B
	bool "realtek rtd1619b"
	depends on ARM64
	select SYNO_LSP_RTD1619B

config SYNO_ICELAKED
       bool "INTEL ICELAKE-D"
       depends on X86_64

config SYNO_EPYC7002
       bool "AMD EPYC Embedded 7002"
       depends on X86_64

config SYNO_EPYC7002SOFS
       bool "AMD EPYC Embedded 7002 with SOFS"
       depends on X86_64

config SYNO_RYZEN5K
       bool "AMD RYZEN Embedded 5000"
       depends on X86_64

config SYNO_EPYC7003NTB
       bool "AMD EPYC Embedded 7003 with NTB"
       depends on X86_64

config SYNO_RAPTORLAKES
       bool "INTEL RAPTOR LAKE-S"
       depends on X86_64

config SYNO_R1000
	bool "AMD Ryzen Embedded R1000"
	depends on X86_64

endchoice

config SYNO_SAS
	bool "Synology SAS Support"
	default y
	depends on SYNO_BROADWELL || SYNO_PURLEY || SYNO_RYZEN5K

config SYNO_AMD_MCE_THRESHOLD_CLEAR
	bool "Clear MCE overflow bit"
	default y
	depends on X86_MCE_AMD

config SYNO_DROP_CACHE_MEM_COMPACT
	bool "Drop cache and compact memory"
	default y
	depends on COMPACTION

config SYNO_INTEL_PSTATE_CALC
	bool "Compare P-state ratio only"
	default y

config SYNO_LSP_RTD1619B
	bool "Apply Realtek rtd1619b LSP"
	depends on ARM64

config SYNO_LSP_RTD1619B_ENABLE_NPU
	bool "Apply Realtek rtd1619b LSP for NPU"
	depends on SYNO_RTD1619B

config SYNO_I915_ENABLE_VCS_ENGINE
	bool "Enable VCS engine"
	default n
	depends on SYNO_GEMINILAKE

endmenu #Platform Features
```
